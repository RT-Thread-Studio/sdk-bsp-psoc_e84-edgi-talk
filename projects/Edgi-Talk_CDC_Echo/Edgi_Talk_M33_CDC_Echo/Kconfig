## projects/Edgi-Talk_CDC_Echo/Edgi_Talk_M33_CDC_Echo/Kconfig
```kconfig
mainmenu "RT-Thread Configuration"

config BSP_DIR
    string
    option env="BSP_ROOT"
    default "."

config RTT_DIR
    string
    option env="RTT_ROOT"
    default "rt-thread"

# you can change the RTT_ROOT default "rt-thread"
# example : default "F:/git_repositories/rt-thread"

config PKGS_DIR
    string
    option env="PKGS_ROOT"
    default "packages"

config ENV_DIR
    string
    option env="ENV_ROOT"
    default "/"

config PLATFORM_DIR
    string
    option env="PLATFORM_DIR"
    default "D:/Desktop/sdk/new/psoc-edge-project/project/Edgi-Talk_emUSB-device_CDC_Echo/Edgi_Talk_M33_emUSB-device_CDC_Echo/platform"

source "$RTT_DIR/Kconfig"
source "$PKGS_DIR/Kconfig"
source "$BSP_DIR/board/Kconfig"
```

## projects/Edgi-Talk_WavPlayer/Edgi_Talk_M33_WavPlayer/board/Kconfig
```kconfig
menu "Hardware Drivers Config"

menu "Select SOC Multi Core Mode"
    config SOC_Enable_CM55
        bool "Enable CM55 Core"
        default y
    config SOC_Enable_CM33_DeepSleep
        bool "Enable CM33 DeepSleep"
        default y
endmenu

config SOC_SERIES_IFX_PSOCE84
    bool 
    select RT_USING_COMPONENTS_INIT
    select RT_USING_USER_MAIN
    default y

config KIT_PROCE84_EVK_M33
    bool 
    default y

menu "Onboard Peripheral Drivers"

    config BSP_USING_USB_TO_UART
        bool "Enable USB TO UART (uart2)"
        select BSP_USING_UART
        select BSP_USING_UART2
        default y

    menuconfig BSP_USING_AUDIO
        bool "Enable Audio Device"
        select RT_USING_AUDIO
        select BSP_USING_I2C
        default n

        if BSP_USING_AUDIO
            config BSP_USING_AUDIO_PLAY
            bool "Enable Audio Play"
            default n

            menuconfig BSP_USING_AUDIO_RECORD
                bool "Enable Audio Record"
                default n
                if BSP_USING_AUDIO_RECORD
                    config  ENABLE_STEREO_INPUT_FEED
                    bool "Enable STEREO INPUT FEED"
                    default y
                endif
        endif

    config BSP_USING_AHT20
        bool "Enable AHT20"
        default n
        select PKG_USING_AHT10
        select BSP_USING_I2C
        if BSP_USING_AHT20
            config PKG_USING_AHT10_SAMPLE 
            bool "Enable AHT20 SAMPLE"
            default n
            if PKG_USING_AHT10_SAMPLE
                config PKG_AHT10_I2C_BUS_NAME
                    string  "PKG_AHT20_I2C_BUS_NAME"
                    default "i2c1"
            endif
        endif
    config BSP_USING_USB
        bool "Enable USB"
        default n
        if BSP_USING_USB
            config BSP_USING_FREERTOS
            bool "Enable FREERTOS ABSTRACTION"
            default n
            select PKG_USING_FREERTOS_WRAPPER
        endif
    config BSP_USING_LSM6DS3
    bool "Enable LSM6DS3"
    default n
    select BSP_USING_I2C

endmenu

menu "On-chip Peripheral Drivers"

    config BSP_USING_GPIO
        bool "Enable GPIO"
        select RT_USING_PIN
        default n

    menuconfig BSP_USING_SPI
        bool "Enable SPI"
        select RT_USING_PIN
        default n
        if BSP_USING_SPI
            config BSP_USING_SPI1
                bool "Enable SPI1"
                default n
            config BSP_USING_SPI2
                bool "Enable SPI2"
                default n
        endif

    menuconfig BSP_USING_ADC
        bool "Enable ADC"
        select RT_USING_ADC
        default n
        if BSP_USING_ADC
            config BSP_USING_ADC1
                bool "Enable ADC1"
                default n
        endif

    menuconfig BSP_USING_I2C
        bool "Enable I2C"
        default n
        select RT_USING_I2C
        if BSP_USING_I2C
            config BSP_USING_HW_I2C0
                bool "Enable HW I2C0"
                default n
            config BSP_USING_SOFT_I2C1
                bool "Enable SOFT I2C1"
                default n
                if BSP_USING_SOFT_I2C1
                    config BSP_SOFT_I2C1_SCL_PIN
                    int "I2C1 SCL PIN number"
                    default 25
                    config BSP_SOFT_I2C1_SDA_PIN
                    int "I2C1 SDA PIN number"
                    default 107
                endif
        endif

    menuconfig BSP_USING_UART
        bool "Enable UART"
        default y
        select RT_USING_SERIAL
        if BSP_USING_UART
            config BSP_USING_UART2
                bool "Enable UART2"
                default y
                
            config BSP_USING_UART5
                bool "Enable UART5"
                default n
        endif

    config BSP_USING_RTC
        bool "Enable RTC"
        select RT_USING_RTC
        default n

        config BSP_USING_HYPERAM
            bool "Enable HYPERAM"
            if BSP_USING_HYPERAM
                config BSP_USING_HYPERAM_SIZE 
                    hex "(HEX)HYPERAM SIZE"
                    default 0x1000000
            endif


    menuconfig BSP_USING_SDCARD
        bool "Enable SDCARD (sd card)"
        select RT_USING_DFS
        select RT_USING_DFS_ELMFAT
        default n
        if BSP_USING_SDCARD
            config BSP_USING_FS
            bool "Enable filesystem"
            default y
        endif


    menuconfig BSP_USING_PWM
        bool "Enable PWM"
        select RT_USING_PWM
        default n
        if BSP_USING_PWM
            config BSP_USING_PWM0
                bool "Enable PWM0"
                default y
        endif

    menuconfig BSP_USING_TIM
        bool "Enable Timer"
        default n
        select RT_USING_HWTIMER
        if BSP_USING_TIM
            config BSP_USING_TIM0
                bool "Enable TIM0"
                default n
        endif
    
    menuconfig BSP_USING_WDT
        bool "Enable WDT"
        select RT_USING_WDT
        default n

    menuconfig BSP_USING_LCD
        bool "Enable MIPI LCD controller"
        select RT_USING_LCD
        default n
    
endmenu
endmenu
```

## projects/Edgi_Talk_CherryUSB/Edgi_Talk_M55_USB_D/Kconfig
```kconfig
mainmenu "RT-Thread Configuration"

config BSP_DIR
    string
    option env="BSP_ROOT"
    default "."

config RTT_DIR
    string
    option env="RTT_ROOT"
    default "rt-thread"

# you can change the RTT_ROOT default "rt-thread"
# example : default "F:/git_repositories/rt-thread"

config PKGS_DIR
    string
    option env="PKGS_ROOT"
    default "packages"

config ENV_DIR
    string
    option env="ENV_ROOT"
    default "/"

config PLATFORM_DIR
    string
    option env="PLATFORM_DIR"
    default "D:/workspace_work/IFX/sdk-bsp-psoc_e84-edgi-talk/projects/Edgi_Talk_CherryUSB/Edgi_Talk_M55_USB/platform"

source "$RTT_DIR/Kconfig"
source "$PKGS_DIR/Kconfig"
source "$RTT_DIR/../libraries/components/CherryUSB-1.6.0/Kconfig.rtt"
source "$RTT_DIR/../libraries/M55_Config/Kconfig"
```

## projects/Edgi_Talk_M33_LSM6DS3/Kconfig
```kconfig
mainmenu "RT-Thread Configuration"

config BSP_DIR
    string
    option env="BSP_ROOT"
    default "."

config RTT_DIR
    string
    option env="RTT_ROOT"
    default "rt-thread"

# you can change the RTT_ROOT default "rt-thread"
# example : default "F:/git_repositories/rt-thread"

config PKGS_DIR
    string
    option env="PKGS_ROOT"
    default "packages"

config ENV_DIR
    string
    option env="ENV_ROOT"
    default "/"

config PLATFORM_DIR
    string
    option env="PLATFORM_DIR"
    default "D:/Desktop/sdk/psoc-edge-project/project/Edgi-Talk_LSM6DS3/Edgi_Talk_M33_LSM6DS3/platform"

source "$RTT_DIR/Kconfig"
source "$PKGS_DIR/Kconfig"
source "$RTT_DIR/../libraries/M33_Config/Kconfig"
```

## projects/Edgi_Talk_M55_WIFI/Kconfig
```kconfig
mainmenu "RT-Thread Configuration"

config BSP_DIR
    string
    option env="BSP_ROOT"
    default "."

config RTT_DIR
    string
    option env="RTT_ROOT"
    default "rt-thread"

# you can change the RTT_ROOT default "rt-thread"
# example : default "F:/git_repositories/rt-thread"

config PKGS_DIR
    string
    option env="PKGS_ROOT"
    default "packages"

config ENV_DIR
    string
    option env="ENV_ROOT"
    default "/"

config PLATFORM_DIR
    string
    option env="PLATFORM_DIR"
    default "D:/Desktop/sdk/new/psoc-edge-project/project/Edgi-Talk_WIFI/Edgi_Talk_M55_WIFI/platform"

source "$RTT_DIR/Kconfig"
source "$PKGS_DIR/Kconfig"
source "$RTT_DIR/../libraries/M55_Config/Kconfig"
```

## projects/Edgi_Talk_M55_XiaoZhi/Kconfig
```kconfig
mainmenu "RT-Thread Configuration"

config BSP_DIR
    string
    option env="BSP_ROOT"
    default "."

config RTT_DIR
    string
    option env="RTT_ROOT"
    default "rt-thread"

# you can change the RTT_ROOT default "rt-thread"
# example : default "F:/git_repositories/rt-thread"

config PKGS_DIR
    string
    option env="PKGS_ROOT"
    default "packages"

config ENV_DIR
    string
    option env="ENV_ROOT"
    default "/"

config PLATFORM_DIR
    string
    option env="PLATFORM_DIR"
    default "D:/workspace_work/IFX/sdk-bsp-psoc_e84-edgi-talk/projects/Edgi-Talk_XiaoZhi/Edgi_Talk_M55_XiaoZhi/platform"

source "$RTT_DIR/Kconfig"
source "$PKGS_DIR/Kconfig"
source "$BSP_DIR/board/Kconfig"
```
