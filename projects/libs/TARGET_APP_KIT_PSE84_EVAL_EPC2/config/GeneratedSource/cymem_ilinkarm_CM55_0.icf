// This file is automatically generated.
define exported symbol CYMEM_CM55_0_m55_data_INTERNAL_START = 0x20000000;
define exported symbol CYMEM_CM55_0_m55_data_SIZE = 0x00040000;
define exported symbol CYMEM_CM55_0_m55_data_OFFSET = 0x00000000;
define exported symbol CYMEM_CM55_0_m55_data_sel_START = CYMEM_CM55_0_m55_data_INTERNAL_START;
define exported symbol CYMEM_CM55_0_m55_code_INTERNAL_START = 0x00000000;
define exported symbol CYMEM_CM55_0_m55_code_SIZE = 0x00040000;
define exported symbol CYMEM_CM55_0_m55_code_OFFSET = 0x00000000;
define exported symbol CYMEM_CM55_0_m55_code_sel_START = CYMEM_CM55_0_m55_code_INTERNAL_START;
define exported symbol CYMEM_CM55_0_user_nvm_C_START = 0x0205B000;
define exported symbol CYMEM_CM55_0_user_nvm_SIZE = 0x00008000;
define exported symbol CYMEM_CM55_0_user_nvm_OFFSET = 0x0005B000;
define exported symbol CYMEM_CM55_0_user_nvm_sel_START = CYMEM_CM55_0_user_nvm_C_START;
define exported symbol CYMEM_CM55_0_m55_nvm_START = 0x60580000;
define exported symbol CYMEM_CM55_0_m55_nvm_SIZE = 0x00A00000;
define exported symbol CYMEM_CM55_0_m55_nvm_OFFSET = 0x00580000;
define exported symbol CYMEM_CM55_0_m55_nvm_sel_START = CYMEM_CM55_0_m55_nvm_START;
define exported symbol CYMEM_CM55_0_m55_trailer_START = 0x60F80000;
define exported symbol CYMEM_CM55_0_m55_trailer_SIZE = 0x00040000;
define exported symbol CYMEM_CM55_0_m55_trailer_OFFSET = 0x00F80000;
define exported symbol CYMEM_CM55_0_m55_trailer_sel_START = CYMEM_CM55_0_m55_trailer_START;
define exported symbol CYMEM_CM55_0_m55_hyperram_START = 0x64200000;
define exported symbol CYMEM_CM55_0_m55_hyperram_SIZE = 0x00200000;
define exported symbol CYMEM_CM55_0_m55_hyperram_OFFSET = 0x00200000;
define exported symbol CYMEM_CM55_0_m55_hyperram_sel_START = CYMEM_CM55_0_m55_hyperram_START;
define exported symbol CYMEM_CM55_0_m33_m55_shared_hyperram_START = 0x64400000;
define exported symbol CYMEM_CM55_0_m33_m55_shared_hyperram_SIZE = 0x00C00000;
define exported symbol CYMEM_CM55_0_m33_m55_shared_hyperram_OFFSET = 0x00400000;
define exported symbol CYMEM_CM55_0_m33_m55_shared_hyperram_sel_START = CYMEM_CM55_0_m33_m55_shared_hyperram_START;
define exported symbol CYMEM_CM55_0_m55_code_secondary_START = 0x26000000;
define exported symbol CYMEM_CM55_0_m55_code_secondary_SIZE = 0x00060000;
define exported symbol CYMEM_CM55_0_m55_code_secondary_OFFSET = 0x00000000;
define exported symbol CYMEM_CM55_0_m55_code_secondary_sel_START = CYMEM_CM55_0_m55_code_secondary_START;
define exported symbol CYMEM_CM55_0_m55_data_secondary_START = 0x26060000;
define exported symbol CYMEM_CM55_0_m55_data_secondary_SIZE = 0x00160000;
define exported symbol CYMEM_CM55_0_m55_data_secondary_OFFSET = 0x00060000;
define exported symbol CYMEM_CM55_0_m55_data_secondary_sel_START = CYMEM_CM55_0_m55_data_secondary_START;
define exported symbol CYMEM_CM55_0_m33_m55_shared_START = 0x261C0000;
define exported symbol CYMEM_CM55_0_m33_m55_shared_SIZE = 0x00040000;
define exported symbol CYMEM_CM55_0_m33_m55_shared_OFFSET = 0x001C0000;
define exported symbol CYMEM_CM55_0_m33_m55_shared_sel_START = CYMEM_CM55_0_m33_m55_shared_START;
define exported symbol CYMEM_CM55_0_gfx_mem_START = 0x26200000;
define exported symbol CYMEM_CM55_0_gfx_mem_SIZE = 0x00300000;
define exported symbol CYMEM_CM55_0_gfx_mem_OFFSET = 0x00200000;
define exported symbol CYMEM_CM55_0_gfx_mem_sel_START = CYMEM_CM55_0_gfx_mem_START;
define exported symbol CYMEM_CM55_0_m33_data_START = 0x240BD000;
define exported symbol CYMEM_CM55_0_m33_data_SIZE = 0x00040000;
define exported symbol CYMEM_CM55_0_m33_data_OFFSET = 0x000BD000;
define exported symbol CYMEM_CM55_0_m33_data_sel_START = CYMEM_CM55_0_m33_data_START;
define exported symbol CYMEM_CM55_0_m33s_allocatable_shared_START = 0x240FD000;
define exported symbol CYMEM_CM55_0_m33s_allocatable_shared_SIZE = 0x00001000;
define exported symbol CYMEM_CM55_0_m33s_allocatable_shared_OFFSET = 0x000FD000;
define exported symbol CYMEM_CM55_0_m33s_allocatable_shared_sel_START = CYMEM_CM55_0_m33s_allocatable_shared_START;
define exported symbol CYMEM_CM55_0_m33_allocatable_shared_START = 0x240FE000;
define exported symbol CYMEM_CM55_0_m33_allocatable_shared_SIZE = 0x00001000;
define exported symbol CYMEM_CM55_0_m33_allocatable_shared_OFFSET = 0x000FE000;
define exported symbol CYMEM_CM55_0_m33_allocatable_shared_sel_START = CYMEM_CM55_0_m33_allocatable_shared_START;
define exported symbol CYMEM_CM55_0_m55_allocatable_shared_START = 0x240FF000;
define exported symbol CYMEM_CM55_0_m55_allocatable_shared_SIZE = 0x00001000;
define exported symbol CYMEM_CM55_0_m55_allocatable_shared_OFFSET = 0x000FF000;
define exported symbol CYMEM_CM55_0_m55_allocatable_shared_sel_START = CYMEM_CM55_0_m55_allocatable_shared_START;
